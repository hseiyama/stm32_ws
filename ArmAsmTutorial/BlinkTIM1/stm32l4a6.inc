GPIOB = 0x48000400

GPIOx_MODER = 0x00
GPIOx_MODER_MODE14_OUT = 0x10000000

GPIOx_OSPEEDR = 0x08
GPIOx_OSPEEDR_OSPEED14_LOW = 0x00000000

GPIOx_BSRR = 0x18
GPIOx_BSRR_BS14 = 0x00004000
GPIOx_BSRR_BR14 = 0x40000000

STK = 0xE000E000
STK_CTRL = 0x10
STK_LOAD = 0x14
STK_VAL = 0x18

RCC = 0x40021000
RCC_AHB2ENR = 0x4C
RCC_AHB2ENR_GPIOBEN = 1
RCC_APB2ENR = 0x60
RCC_APB2ENR_TIM1EN = 11

TIM1 = 0x40012C00

TIMx_CR1 = 0x00
TIMx_CR1_URS = 2
TIMx_CR1_CEN = 0

TIMx_DIER = 0x0C
TIMx_DIER_UIE = 0

TIMx_SR = 0x10
TIMx_SR_UIF = 0

TIMx_EGR = 0x14
TIMx_EGR_UG = 0

TIMx_PSC = 0x28
TIMx_ARR = 0x2C

TIM1_UP_IRQn = 25

NVIC_ISER0 = 0xE000E100
