RCC = 0x40021000
RCC_IOPENR = 0x34
RCC_IOPENR_GPIOAEN = 0
RCC_APBENR2= 0x40
RCC_APBENR2_TIM1EN = 11

GPIOA = 0x50000000

GPIOx_MODER = 0x00
GPIOx_MODER_MODE5_OUT = 0x00000400

GPIOx_OSPEEDR = 0x08
GPIOx_OSPEEDR_OSPEED5_LOW = 0x00000000

GPIOx_BSRR = 0x18
GPIOx_BSRR_BS5 = 0x00000020
GPIOx_BSRR_BR5 = 0x00200000

STK = 0xE000E000
STK_CSR = 0x10
STK_RVR = 0x14
STK_CVR = 0x18

TIM1 = 0x40012C00

TIMx_CR1 = 0x00
TIMx_CR1_URS = 2
TIMx_CR1_CEN = 0

TIMx_DIER = 0x0C
TIMx_DIER_UIE = 0

TIMx_SR = 0x10
TIMx_SR_UIF = 0

TIMx_EGR = 0x14
TIMx_EGR_UG = 0

TIMx_PSC = 0x28
TIMx_ARR = 0x2C

TIM1_UP_IRQn = 13

NVIC_ISER = 0xE000E100
